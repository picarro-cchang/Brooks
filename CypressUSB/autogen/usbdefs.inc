USB_VERSION EQU 1001
CYPRESS_FX2_VID EQU 0x4B4
CYPRESS_FX2_PID EQU 0x8613
INITIAL_VID EQU 0x3EF
INITIAL_PID EQU 0x1000
INSTRUMENT_VID EQU 0x3EF
INSTRUMENT_PID EQU 0x1001
VENDOR_GET_VERSION EQU 0xB0
VENDOR_FPGA_CONFIGURE EQU 0xC0
VENDOR_READ_HPIC EQU 0xC1
VENDOR_WRITE_HPIC EQU 0xC2
VENDOR_READ_HPIA EQU 0xC3
VENDOR_WRITE_HPIA EQU 0xC4
VENDOR_SET_HPID_IN_BYTES EQU 0xC5
VENDOR_RESET_HPID_IN_FIFO EQU 0xC6
VENDOR_GET_STATUS EQU 0xC7
VENDOR_DSP_CONTROL EQU 0xC8
VENDOR_SET_DAC EQU 0xC9
VENDOR_DAC_QUEUE_CONTROL EQU 0xCA
VENDOR_DAC_QUEUE_STATUS EQU 0xCB
FPGA_START_PROGRAM EQU 0x01
FPGA_SEND_DATA EQU 0x02
FPGA_GET_STATUS EQU 0x03
USB_STATUS_SPEED EQU 0x01
USB_STATUS_GPIFTRIG EQU 0x02
USB_STATUS_GPIFTC EQU 0x03
VENDOR_DSP_CONTROL_RESET EQU 0x01
VENDOR_DSP_CONTROL_HINT EQU 0x02
DAC_QUEUE_RESET EQU 0x01
DAC_QUEUE_SERVE EQU 0x02
DAC_QUEUE_SET_PERIOD EQU 0x03
DAC_SET_TIMESTAMP EQU 0x04
DAC_SET_RELOAD_COUNT EQU 0x05
DAC_QUEUE_GET_FREE EQU 0x01
DAC_QUEUE_GET_ERRORS EQU 0x02
DAC_GET_TIMESTAMP EQU 0x03
DAC_GET_RELOAD_COUNT EQU 0x04
IO_FPGA_CONF EQU IOE
CYP_LED0 EQU 0x01
CYP_LED1 EQU 0x02
CYP_LED2 EQU 0x80
FPGA_SS_CCLK EQU 0x04
FPGA_SS_DIN EQU 0x08
FPGA_SS_PROG EQU 0x10
FPGA_SS_INIT EQU 0x20
FPGA_SS_DONE EQU 0x40
CYP_LED3 EQU 0x10
DAC_IMMEDIATE EQU 0xD1
DAC_ENQUEUE EQU 0xD2
DAC_QUEUE_OVERFLOW EQU 0x1
DAC_QUEUE_UNDERFLOW EQU 0x2
